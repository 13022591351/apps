## DuoYuWang/mqttc/Kconfig
```kconfig
#
# For a description of the syntax of this configuration file,
# see the file kconfig-language.txt in the NuttX tools repository.
#

config DYW_MQTTC
	tristate "Enable MQTT-C"
	default n
	---help---
		Enable MQTT-C

if DYW_MQTTC

config DYW_MQTTC_WITH_MBEDTLS
	bool "Enable MQTT-C with mbedtls"
	default n

endif
```

## DuoYuWang/ntrip_client/Kconfig
```kconfig
#
# For a description of the syntax of this configuration file,
# see the file kconfig-language.txt in the NuttX tools repository.
#

config DYW_NTRIP_CLIENT
	tristate "\"Ntrip Client\" App"
	default n
	depends on NET_TCP
	---help---
		Enable the \"Ntrip Client\" App

if DYW_NTRIP_CLIENT

config DYW_NTRIP_CLIENT_PROGNAME
	string "Program name"
	default "ntrip_client"

config DYW_NTRIP_CLIENT_PRIORITY
	int "Ntrip Client task priority"
	default 100

config DYW_NTRIP_CLIENT_STACKSIZE
	int "Ntrip Client stack size"
	default DEFAULT_TASK_STACKSIZE

config DYW_NTRIP_DBG_ERR
	tristate "NTRIP printf err"
	default n

config DYW_NTRIP_DBG_INFO
	tristate "NTRIP printf info"
	default n

endif
```

## DuoYuWang/rtcm3_proxy/Kconfig
```kconfig
#
# For a description of the syntax of this configuration file,
# see the file kconfig-language.txt in the NuttX tools repository.
#

config DYW_RTCM3_PROXY
	tristate "\"RTCM3 Proxy\" App"
	default n
	---help---
		Enable the \"RTCM3 Proxy\" App

if DYW_RTCM3_PROXY

config DYW_RTCM3_PROXY_PROGNAME
	string "Program name"
	default "rtcm3_proxy"
	---help---
		This is the name of the program that will be used when the NSH ELF
		program is installed.

config DYW_RTCM3_PROXY_PRIORITY
	int "RTCM3 Proxy task priority"
	default 100

config DYW_RTCM3_PROXY_STACKSIZE
	int "RTCM3 Proxy stack size"
	default DEFAULT_TASK_STACKSIZE

config DYW_RTCM3_PROXY_DBG_ERR
	tristate "RTCM3 Proxy printf err"
	default n

config DYW_RTCM3_PROXY_DBG_INFO
	tristate "RTCM3 Proxy printf info"
	default n

endif
```

## DuoYuWang/unicore/Kconfig
```kconfig
#
# For a description of the syntax of this configuration file,
# see the file kconfig-language.txt in the NuttX tools repository.
#

config DYW_UNICORE
	tristate "\"UniCore\" App"
	default n
	depends on NET_TCP
	---help---
		Enable the \"UniCore\" App

if DYW_UNICORE

config DYW_UNICORE_PROGNAME
	string "Program name"
	default "unicore"
	---help---
		This is the name of the program that will be used when the NSH ELF
		program is installed.

config DYW_UNICORE_PRIORITY
	int "UniCore task priority"
	default 100

config DYW_UNICORE_STACKSIZE
	int "UniCore stack size"
	default DEFAULT_TASK_STACKSIZE

config DYW_UNICORE_DBG_ERR
	tristate "UniCore printf err"
	default n

config DYW_UNICORE_DBG_INFO
	tristate "UniCore printf info"
	default n

config DYW_UNICORE_RTCM_PROXY
	bool "Use UniCore RTCM proxy"
	default n
	---help---
		Select if use UniCore RTCM proxy

endif
```

## DuoYuWang/uorb_fmu/Kconfig
```kconfig
#
# For a description of the syntax of this configuration file,
# see the file kconfig-language.txt in the NuttX tools repository.
#

config DYW_UORB_FMU
	tristate "Enable uORB FMU"
	default n
```

## DuoYuWang/webserver_fmu/Kconfig
```kconfig
config DYW_WEBSERVER_FMU
	tristate "FMU web server example"
	default n
	---help---
		Enable the FMU web server example

if DYW_WEBSERVER_FMU

config DYW_WEBSERVER_FMU_PROGNAME
	string "Program name"
	default "webserver"
	---help---
		This is the name of the program that will be used when the NSH ELF
		program is installed.

config DYW_WEBSERVER_FMU_PRIORITY
	int "WEBSERVER_FMU task priority"
	default 100

config DYW_WEBSERVER_FMU_STACKSIZE
	int "WEBSERVER_FMU stack size"
	default DEFAULT_TASK_STACKSIZE

endif
```
